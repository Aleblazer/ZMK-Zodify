## boards/shields/zodify/Kconfig.defconfig
```kconfig
if SHIELD_ZODIFY_LEFT

# Name must be less than 16 characters long!
config ZMK_KEYBOARD_NAME
    default "Zodify"

config ZMK_SPLIT_ROLE_CENTRAL
    default y

endif

if SHIELD_ZODIFY_LEFT || SHIELD_ZODIFY_RIGHT

config ZMK_SPLIT
    default y

endif

if ZMK_DISPLAY

config I2C
    default y

config SSD1306
    default y

endif # ZMK_DISPLAY

endif
```
